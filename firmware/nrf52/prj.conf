## CMakeLists.txt
```
cmake_minimum_required(VERSION 3.20.0)
find_package(Zephyr REQUIRED HINTS $ENV{ZEPHYR_BASE})
project(chip_ai_nrf52)

target_sources(app PRIVATE
    src/main.c
    src/board_nrf52.c
    src/ble_gatt.c
    ../shared/cai_app.c
    ../shared/cai_protocol.c
    ../../core/src/cai_runtime.c
    ../../core/src/cai_tensor.c
    ../../core/src/cai_stub_backend.c
)

target_include_directories(app PRIVATE
    src
    ../shared
    ../../core/include
)
```

## prj.conf
```kconfig
CONFIG_GPIO=y
CONFIG_LOG=y
CONFIG_MAIN_STACK_SIZE=4096
CONFIG_BT=y
CONFIG_BT_PERIPHERAL=y
CONFIG_BT_DEVICE_NAME="ChipAI"
CONFIG_BT_MAX_CONN=1
CONFIG_BT_GATT_DYNAMIC_DB=y
```

## src/main.c
```c
#include "board_nrf52.h"
#include "ble_gatt.h"

#include "cai_app.h"

#include <string.h>
#include <zephyr/kernel.h>
#include <zephyr/logging/log.h>

LOG_MODULE_REGISTER(chip_ai, LOG_LEVEL_INF);

static cai_app_t s_app;

static uint8_t s_stub_model[16] = {
    0x00, 0x00, 0x80, 0x3f,
    0x00, 0x00, 0x00, 0x3f,
    0xcd, 0xcc, 0x4c, 0xbe,
    0xcd, 0xcc, 0xcc, 0x3d,
};

int main(void)
{
    board_nrf52_init();

    cai_ble_ops_t ble_ops = {
        .notify_status = ble_gatt_notify_status,
        .notify_result = ble_gatt_notify_result,
        .on_error = ble_gatt_notify_error,
        .ble_ctx = NULL,
    };
    cai_app_init(&s_app, board_nrf52_ops(), &ble_ops);

    cai_model_meta_t meta = {
        .label_count = 3,
        .threshold = 0.5f,
    };
    strncpy(meta.labels[0], "idle", CAI_LABEL_LEN - 1);
    strncpy(meta.labels[1], "walk", CAI_LABEL_LEN - 1);
    strncpy(meta.labels[2], "run", CAI_LABEL_LEN - 1);
    if (cai_app_load_model(&s_app, s_stub_model, sizeof(s_stub_model), &meta) != 0) {
        LOG_ERR("model load failed");
        return -1;
    }

    if (ble_gatt_init(&s_app) != 0) {
        LOG_ERR("ble init failed");
        return -1;
    }

    s_app.infer_enabled = true;
    LOG_INF("ChipAI nRF52 firmware ready");

    while (1) {
        cai_app_tick(&s_app);
        k_sleep(K_MSEC(10));
    }
    return 0;
}
```

## src/ble_gatt.c
```c
#include "ble_gatt.h"
#include "cai_protocol.h"

#include <zephyr/bluetooth/bluetooth.h>
#include <zephyr/bluetooth/gatt.h>
#include <zephyr/bluetooth/hci.h>
#include <zephyr/bluetooth/uuid.h>
#include <zephyr/kernel.h>
#include <string.h>

static cai_app_t *s_app;
static bool s_connected;
static struct bt_conn *s_conn;

static struct bt_uuid_128 uuid_svc = BT_UUID_INIT_128(
    0x01, 0x10, 0xca, 0x00, 0x00, 0x00, 0x00, 0x80,
    0x00, 0x40, 0x01, 0x00, 0x00, 0xa1, 0x10, 0xca);
static struct bt_uuid_128 uuid_control = BT_UUID_INIT_128(
    0x03, 0x10, 0xca, 0x00, 0x00, 0x00, 0x00, 0x80,
    0x00, 0x40, 0x01, 0x00, 0x00, 0xa1, 0x10, 0xca);
static struct bt_uuid_128 uuid_status = BT_UUID_INIT_128(
    0x01, 0x10, 0xca, 0x00, 0x00, 0x00, 0x00, 0x80,
    0x00, 0x40, 0x01, 0x00, 0x00, 0xa1, 0x10, 0xca);
static struct bt_uuid_128 uuid_result = BT_UUID_INIT_128(
    0x02, 0x10, 0xca, 0x00, 0x00, 0x00, 0x00, 0x80,
    0x00, 0x40, 0x01, 0x00, 0x00, 0xa1, 0x10, 0xca);
static struct bt_uuid_128 uuid_info = BT_UUID_INIT_128(
    0x04, 0x10, 0xca, 0x00, 0x00, 0x00, 0x00, 0x80,
    0x00, 0x40, 0x01, 0x00, 0x00, 0xa1, 0x10, 0xca);

static uint8_t status_ccc_cfg_changed;
static uint8_t result_ccc_cfg_changed;
static char s_device_name[24] = "ChipAI-0000";

#define STATUS_ATTR_INDEX 4
#define RESULT_ATTR_INDEX 7

static ssize_t on_control_write(struct bt_conn *conn, const struct bt_gatt_attr *attr,
                                const void *buf, uint16_t len, uint16_t offset, uint8_t flags)
{
    ARG_UNUSED(conn);
    ARG_UNUSED(attr);
    ARG_UNUSED(offset);
    ARG_UNUSED(flags);

    if (s_app != NULL) {
        cai_app_on_control_write(s_app, buf, len);
    }
    return len;
}

static ssize_t on_status_read(struct bt_conn *conn, const struct bt_gatt_attr *attr,
                              void *buf, uint16_t len, uint16_t offset)
{
    ARG_UNUSED(attr);

    if (s_app == NULL) {
        return BT_GATT_ERR(BT_ATT_ERR_UNLIKELY);
    }

    const cai_status_t *st = cai_app_status(s_app);
    uint8_t pl[CAI_MAX_PAYLOAD];
    size_t plen = cai_build_status_payload(st, pl, sizeof(pl));
    uint8_t frame[32];
    size_t fn = cai_encode_frame(CAI_EVT_STATUS, pl, (uint8_t)plen, frame, sizeof(frame));
    return bt_gatt_attr_read(conn, attr, buf, len, offset, frame, fn);
}

static ssize_t on_info_read(struct bt_conn *conn, const struct bt_gatt_attr *attr,
                            void *buf, uint16_t len, uint16_t offset)
{
    ARG_UNUSED(attr);
    static const char info[] = "ChipAI-nRF52-v1.0.0";
    return bt_gatt_attr_read(conn, attr, buf, len, offset, info, sizeof(info) - 1);
}

BT_GATT_SERVICE_DEFINE(cai_svc,
    BT_GATT_PRIMARY_SERVICE(&uuid_svc),
    BT_GATT_CHARACTERISTIC(&uuid_control.uuid,
                           BT_GATT_CHRC_WRITE | BT_GATT_CHRC_WRITE_WITHOUT_RESP,
                           BT_GATT_PERM_WRITE,
                           NULL, on_control_write, NULL),
    BT_GATT_CHARACTERISTIC(&uuid_status.uuid,
                           BT_GATT_CHRC_READ | BT_GATT_CHRC_NOTIFY,
                           BT_GATT_PERM_READ,
                           on_status_read, NULL, NULL),
    BT_GATT_CCC(&status_ccc_cfg_changed, BT_GATT_PERM_READ | BT_GATT_PERM_WRITE),
    BT_GATT_CHARACTERISTIC(&uuid_result.uuid,
                           BT_GATT_CHRC_NOTIFY,
                           BT_GATT_PERM_NONE,
                           NULL, NULL, NULL),
    BT_GATT_CCC(&result_ccc_cfg_changed, BT_GATT_PERM_READ | BT_GATT_PERM_WRITE),
    BT_GATT_CHARACTERISTIC(&uuid_info.uuid,
                           BT_GATT_CHRC_READ,
                           BT_GATT_PERM_READ,
                           on_info_read, NULL, NULL)
);

static int notify_frame(uint8_t attr_index, uint8_t evt_cmd,
                        const uint8_t *payload, uint8_t payload_len)
{
    if (!s_connected || s_conn == NULL) {
        return 0;
    }

    uint8_t frame[6 + CAI_MAX_PAYLOAD];
    size_t n = cai_encode_frame(evt_cmd, payload, payload_len, frame, sizeof(frame));
    if (n == 0) {
        return -EINVAL;
    }

    return bt_gatt_notify(s_conn, &cai_svc.attrs[attr_index], frame, n);
}

void ble_gatt_notify_status(uint8_t evt_cmd, const uint8_t *payload, uint8_t len, void *ctx)
{
    ARG_UNUSED(ctx);
    notify_frame(STATUS_ATTR_INDEX, evt_cmd, payload, len);
}

void ble_gatt_notify_result(uint8_t evt_cmd, const uint8_t *payload, uint8_t len, void *ctx)
{
    ARG_UNUSED(ctx);
    notify_frame(RESULT_ATTR_INDEX, evt_cmd, payload, len);
}

void ble_gatt_notify_error(uint8_t code, void *ctx)
{
    ARG_UNUSED(ctx);
    notify_frame(STATUS_ATTR_INDEX, CAI_EVT_ERROR, &code, 1);
}

static void connected(struct bt_conn *conn, uint8_t err)
{
    if (err) {
        return;
    }
    s_conn = bt_conn_ref(conn);
    s_connected = true;
    if (s_app) {
        cai_app_set_connected(s_app, true);
    }
}

static void disconnected(struct bt_conn *conn, uint8_t reason)
{
    ARG_UNUSED(reason);
    if (s_conn) {
        bt_conn_unref(s_conn);
        s_conn = NULL;
    }
    s_connected = false;
    if (s_app) {
        cai_app_set_connected(s_app, false);
    }
}

BT_CONN_CB_DEFINE(conn_cb) = {
    .connected = connected,
    .disconnected = disconnected,
};

static void set_adv_name(void)
{
    bt_addr_le_t addrs[1];
    size_t count = 1;

    bt_id_get(addrs, &count);
    snprintk(s_device_name, sizeof(s_device_name), "ChipAI-%02X%02X",
             addrs[0].a.val[4], addrs[0].a.val[5]);
    bt_set_name(s_device_name);
}

static const struct bt_data ad[] = {
    BT_DATA_BYTES(BT_DATA_FLAGS, (BT_LE_AD_GENERAL | BT_LE_AD_NO_BREDR)),
    BT_DATA(BT_DATA_UUID128_ALL, uuid_svc.val, sizeof(uuid_svc.val)),
};

static struct bt_data sd;

static void advertise(void)
{
    sd = (struct bt_data)BT_DATA(BT_DATA_NAME_COMPLETE,
                                 s_device_name,
                                 strlen(s_device_name));
    bt_le_adv_start(BT_LE_ADV_CONN, ad, ARRAY_SIZE(ad), &sd, 1);
}

int ble_gatt_init(cai_app_t *app)
{
    s_app = app;
    int err = bt_enable(NULL);
    if (err) {
        return err;
    }
    set_adv_name();
    advertise();
    return 0;
}
```

## src/ble_gatt.h
```c
#ifndef BLE_GATT_NRF_H
#define BLE_GATT_NRF_H

#include "cai_app.h"
#include <stddef.h>
#include <stdint.h>

int ble_gatt_init(cai_app_t *app);
void ble_gatt_notify_status(uint8_t evt_cmd, const uint8_t *payload, uint8_t len, void *ctx);
void ble_gatt_notify_result(uint8_t evt_cmd, const uint8_t *payload, uint8_t len, void *ctx);
void ble_gatt_notify_error(uint8_t code, void *ctx);

#endif
```

## src/board_nrf52.c
```c
#include "board_nrf52.h"

#include <zephyr/kernel.h>
#include <zephyr/drivers/gpio.h>

#define CAI_LED_NODE DT_ALIAS(led0)

static const struct gpio_dt_spec led = GPIO_DT_SPEC_GET(CAI_LED_NODE, gpios);

static uint16_t read_sensor_adc(uint8_t channel, void *ctx)
{
    (void)ctx;
    return (uint16_t)(1000 + channel * 300);
}

static uint8_t read_battery_pct(void *ctx)
{
    (void)ctx;
    return 92;
}

static uint32_t millis(void *ctx)
{
    (void)ctx;
    return k_uptime_get_32();
}

static void set_led(bool on, void *ctx)
{
    (void)ctx;
    if (device_is_ready(led.port)) {
        gpio_pin_set_dt(&led, on ? 1 : 0);
    }
}

static cai_board_ops_t s_ops;

void board_nrf52_init(void)
{
    if (device_is_ready(led.port)) {
        gpio_pin_configure_dt(&led, GPIO_OUTPUT_INACTIVE);
    }

    s_ops.read_sensor_adc = read_sensor_adc;
    s_ops.read_battery_pct = read_battery_pct;
    s_ops.millis = millis;
    s_ops.set_led = set_led;
    s_ops.board_ctx = NULL;
}

const cai_board_ops_t *board_nrf52_ops(void)
{
    return &s_ops;
}
```

## src/board_nrf52.h
```c
#ifndef BOARD_NRF52_H
#define BOARD_NRF52_H

#include "cai_app.h"

void board_nrf52_init(void);
const cai_board_ops_t *board_nrf52_ops(void);

#endif /* BOARD_NRF52_H */
```
